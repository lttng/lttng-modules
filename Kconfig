## Kconfig
```kconfig
# SPDX-License-Identifier: (GPL-2.0 or LGPL-2.1)

config LTTNG
	tristate "LTTng support"
	select TRACING
	help
	  LTTng is an open source tracing framework for Linux.

	  See https://lttng.org/

	  To compile as a set of modules, choose M here. To compile into
	  the Linux kernel image, choose Y.

	  If unsure, say N.

source "lttng/tests/Kconfig"
```

## src/Kconfig
```kconfig
# SPDX-License-Identifier: (GPL-2.0-only or LGPL-2.1-only)

config LTTNG
	tristate "LTTng support"
	default m
	select TRACING
	help
	  LTTng is an open source tracing framework for Linux.

	  See https://lttng.org/

	  To compile as a set of modules, choose M here. To compile into
	  the Linux kernel image, choose Y.

	  If unsure, say N.

config LTTNG_EXPERIMENTAL_BITWISE_ENUM
	bool "LTTng experimental bitwise enum support"
	default n
	depends on LTTNG
	help
	  Enable experimental bitwise enumerations. The traces produced with
	  this option enabled will generate warnings when read by trace
	  viewers with default options.

	  If unsure, say N.

config LTTNG_SYSCALLS_EXTRACTOR
	bool "LTTng syscalls extraction helper"
	default n
	depends on LTTNG
	help
	  Enable the LTTng system call extraction helper which prints the list
	  of enabled system calls, along with their signature, to dmesg. This
	  is not meant for mainline; it is a development helper.

source "lttng/src/tests/Kconfig"
```

## src/tests/Kconfig
```kconfig
# SPDX-License-Identifier: (GPL-2.0-only or LGPL-2.1-only)
# SPDX-FileCopyrightText: 2016-2024 EfficiOS Inc.

config LTTNG_CLOCK_PLUGIN_TEST
       tristate "Use test plugin as trace clock"
       default m
       depends on LTTNG
       help
	 Use the test clock as trace clock. This plugin freezes the
	 time with 1 KHz for regression test.
	 It's recommended to build this as a module to work with the
	 lttng-tools test suite.
```

## tests/Kconfig
```kconfig
config LTTNG_CLOCK_PLUGIN_TEST
       tristate "Use test plugin as trace clock"
       depends on LTTNG
       help
	 Use the test clock as trace clock. This plugin freezes the
	 time with 1 KHz for regression test.
	 It's recommended to build this as a module to work with the
	 lttng-tools test suite.
```
